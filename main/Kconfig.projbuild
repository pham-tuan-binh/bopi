## main/Kconfig.projbuild
```kconfig
menu "Bopi"

    choice LK_BOPI_CONNECTION_METHOD
        prompt "Choose room connection method"
        help
            Choose how to connect to the room.

        config LK_BOPI_USE_SANDBOX
            bool "Sandbox token"
            help
                Use a sandbox token server for room authentication.

        config LK_BOPI_USE_PREGENERATED
            bool "Pre-generated token"
            help
                Use a pre-generated token and server URL for room connection.
    endchoice

    config LK_BOPI_SERVER_URL
        depends on LK_BOPI_USE_PREGENERATED
        string "Server URL"
        default "ws://localhost:7880"
        help
            The server URL to use for room connection.
    config LK_BOPI_TOKEN
        depends on LK_BOPI_USE_PREGENERATED
        string "Token"
        help
            The token to use for room connection.

    config LK_BOPI_SANDBOX_ID
        depends on LK_BOPI_USE_SANDBOX
        string "Sandbox ID"
        help
            The ID of the sandbox token server to use.
    config LK_BOPI_ROOM_NAME
        depends on LK_BOPI_USE_SANDBOX
        string "Room name (optional)"
        help
            Specific room name sandbox tokens will be generated with.
    config LK_BOPI_PARTICIPANT_NAME
        depends on LK_BOPI_USE_SANDBOX
        string "Participant name (optional)"
        help
            Specific participant name sandbox tokens will be generated with.

    config LK_BOPI_SPEAKER_VOLUME
        int "Default speaker volume (0-100%)"
        default 85
        range 0 100
        help
            Default playback volume for speaker output.
endmenu
```

## sdkconfig.defaults
```kconfig
CONFIG_IDF_TARGET="esp32s3"
CONFIG_LK_BOPI_SPEAKER_VOLUME=100

CONFIG_CODEC_I2C_BACKWARD_COMPATIBLE=y
CONFIG_COMPILER_OPTIMIZATION_PERF=y
CONFIG_ESP_DEFAULT_CPU_FREQ_MHZ_240=y
CONFIG_ESP_WS_CLIENT_ENABLE_DYNAMIC_BUFFER=y
CONFIG_ESP_WS_CLIENT_SEPARATE_TX_LOCK=y
CONFIG_ESP32S3_DATA_CACHE_64KB=y
CONFIG_ESP32S3_DATA_CACHE_LINE_64B=y
CONFIG_ESP32S3_INSTRUCTION_CACHE_32KB=y
CONFIG_ESPTOOLPY_FLASHMODE_QIO=y
CONFIG_ESPTOOLPY_FLASHSIZE_16MB=y
CONFIG_FREERTOS_HZ=1000
CONFIG_FREERTOS_TIMER_TASK_STACK_DEPTH=4096
CONFIG_IDF_EXPERIMENTAL_FEATURES=y
CONFIG_LWIP_SNTP_MAX_SERVERS=2
CONFIG_MBEDTLS_EXTERNAL_MEM_ALLOC=y
CONFIG_MBEDTLS_SSL_DTLS_SRTP=y
CONFIG_MBEDTLS_SSL_PROTO_DTLS=y
CONFIG_PARTITION_TABLE_CUSTOM=y
CONFIG_SPIRAM_FETCH_INSTRUCTIONS=y
CONFIG_SPIRAM_MALLOC_ALWAYSINTERNAL=256
CONFIG_SPIRAM_MALLOC_RESERVE_INTERNAL=8192
CONFIG_SPIRAM_MODE_OCT=y
CONFIG_SPIRAM_SPEED_80M=y
CONFIG_SPIRAM_TRY_ALLOCATE_WIFI_LWIP=y
CONFIG_SPIRAM=y

CONFIG_LV_MEM_CUSTOM=y
CONFIG_LV_COLOR_16_SWAP=y
CONFIG_LV_FONT_MONTSERRAT_24=y
CONFIG_ESP_MAIN_TASK_STACK_SIZE=8192
CONFIG_FATFS_LFN_HEAP=y
CONFIG_FATFS_MAX_LFN=255
CONFIG_LVGL_PORT_TASK_AFFINITY_CPU1=y
CONFIG_LVGL_DRAW_BUFF_HEIGHT=50
CONFIG_ESP_TASK_WDT_CHECK_IDLE_TASK_CPU1=n
CONFIG_LV_USE_GIF=y
CONFIG_LV_USE_FS_POSIX=y
CONFIG_LV_FS_POSIX_LETTER=83
CONFIG_LV_FS_POSIX_PATH="/sdcard"
CONFIG_LV_FS_POSIX_CACHE_SIZE=4096

# Keep backlight off during bsp_lvgl_init — screen_init() turns it on
# after painting the first black frame.
CONFIG_BSP_LCD_DEFAULT_BRIGHTNESS=0
```
